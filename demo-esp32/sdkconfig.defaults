## demo-esp32/sdkconfig.defaults
```kconfig
CONFIG_COMPILER_CXX_EXCEPTIONS=n
CONFIG_ESP_MAIN_TASK_STACK_SIZE=10240
CONFIG_PTHREAD_TASK_STACK_SIZE_DEFAULT=10240
CONFIG_COMPILER_OPTIMIZATION_SIZE=y

CONFIG_ESPTOOLPY_FLASHSIZE_4MB=y
CONFIG_PARTITION_TABLE_CUSTOM=y
CONFIG_PARTITION_TABLE_CUSTOM_FILENAME="partitions.csv"
CONFIG_PARTITION_TABLE_FILENAME="partitions.csv"

CONFIG_FREERTOS_HZ=1000
CONFIG_FREERTOS_IDLE_TASK_STACKSIZE=2304
CONFIG_FREERTOS_MAX_TASK_NAME_LEN=32
CONFIG_FREERTOS_TASK_FUNCTION_WRAPPER=y
CONFIG_MB_TIMER_PORT_ENABLED=y

CONFIG_BOOTLOADER_APP_ROLLBACK_ENABLE=y
CONFIG_ESPTOOLPY_FLASHFREQ_80M=y

CONFIG_HEAP_USE_HOOKS=y
CONFIG_ESP_BROWNOUT_DET=n
CONFIG_ESP_SYSTEM_BROWNOUT_INTR=n
CONFIG_SPI_FLASH_BROWNOUT_RESET_XMC=n
CONFIG_SPI_FLASH_BROWNOUT_RESET=n

CONFIG_ESP_HTTPS_SERVER_ENABLE=y
CONFIG_HTTPD_MAX_REQ_HDR_LEN=1024
CONFIG_MBEDTLS_CERTIFICATE_BUNDLE=y

# Minimizing wifi buffer usage - using "Minimum" profile:
# https://docs.espressif.com/projects/esp-idf/en/stable/esp32/api-guides/wifi.html#how-to-configure-parameters
CONFIG_ESP_WIFI_STATIC_RX_BUFFER_NUM=4
CONFIG_ESP_WIFI_DYNAMIC_RX_BUFFER_NUM=8
CONFIG_ESP_WIFI_DYNAMIC_TX_BUFFER_NUM=8
CONFIG_ESP_WIFI_RX_BA_WIN=Disable
CONFIG_LWIP_TCP_WND_DEFAULT=8
TCP_WND_DEFAULT=8
CONFIG_ESP_WIFI_IRAM_OPT=ENABLE
CONFIG_ESP_WIFI_RX_IRAM_OPT=ENABLE
CONFIG_LWIP_IRAM_OPTIMIZATION=ENABLE

# Minimizing TLS heap usage:
# https://docs.espressif.com/projects/esp-idf/en/stable/esp32/api-reference/protocols/mbedtls.html#reducing-heap-usage
# CONFIG_MBEDTLS_SSL_VARIABLE_BUFFER_LENGTH=y
CONFIG_MBEDTLS_SSL_KEEP_PEER_CERTIFICATE=n
# CONFIG_MBEDTLS_DYNAMIC_BUFFER=y
CONFIG_MBEDTLS_DYNAMIC_FREE_CONFIG_DATA=y
CONFIG_MBEDTLS_DYNAMIC_FREE_CA_CERT=y

# Note: disabling dynamic buffers - failing in esp_http_client_read during firmware update
CONFIG_MBEDTLS_SSL_VARIABLE_BUFFER_LENGTH=n
CONFIG_MBEDTLS_DYNAMIC_BUFFER=n
CONFIG_MBEDTLS_SSL_OUT_CONTENT_LEN=1024
```
